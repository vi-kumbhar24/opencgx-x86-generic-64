## layers/meta-montavista-x86-generic/conf/layer.conf
```bitbake
# We have a conf and classes directory, add to BBPATH
BBPATH := "${BBPATH}:${LAYERDIR}"

# We have an images and various recipe-* directories, add to BBFILES
BBFILES := "${BBFILES} ${LAYERDIR}/recipes*/*/*.bb*"
	
BBFILE_COLLECTIONS += "cgx-msd-x86-generic"
BBFILE_PATTERN_cgx-msd-x86-generic := "^${LAYERDIR}/"
BBFILE_PRIORITY_cgx-msd-x86-generic = "7"

LAYERSERIES_COMPAT_cgx-msd-x86-generic = "dunfell"

LAYERDEPENDS_template = "core "
```

## layers/meta-montavista-x86-generic/conf/machine/x86-atom-64.conf
```bitbake
#@TYPE: Machine
#@NAME: x86-atom-64 
#@DESCRIPTION: Machine configuration for running a x86-atom-64 machine

DEFAULTTUNE ?= "core2-64"
require conf/machine/include/tune-core2.inc
require conf/machine/include/qemu.inc
require conf/machine/include/qemuboot-x86.inc
QB_OPT_APPEND = "-vga vmware -show-cursor -usb -usbdevice tablet -device virtio-rng-pci -smp 2"
#Kernel requires moveb update cpu
QB_CPU_x86-64 = "-cpu Broadwell"

PREFERRED_PROVIDER_virtual/xserver ?= "xserver-xorg"
PREFERRED_PROVIDER_virtual/libgl ?= "mesa"
PREFERRED_PROVIDER_virtual/libgles1 ?= "mesa"
PREFERRED_PROVIDER_virtual/libgles2 ?= "mesa"

KERNEL_IMAGETYPE = "bzImage"

SERIAL_CONSOLE = "115200 ttyS0"

MSD = "x86-atom-64"

# The MACHINE name identifies the default supported hardware platform.
MACHINE = "x86-atom-64"



XSERVER = "xserver-xorg \
           ${@bb.utils.contains('DISTRO_FEATURES', 'opengl', 'mesa-driver-swrast', '', d)} \
           xf86-input-vmmouse \
           xf86-input-keyboard \
           xf86-input-evdev \
           xf86-video-cirrus \
           xf86-video-fbdev \
           xf86-video-vmware \
           xf86-video-ast"

MACHINE_FEATURES += "x86"

MACHINE_ESSENTIAL_EXTRA_RDEPENDS += "v86d"
PREFERRED_PROVIDER_virtual/kernel = "linux-yocto"
```

## layers/meta-montavista-x86-generic/conf/machine/x86-generic-64.conf
```bitbake
#@TYPE: Machine
#@NAME: x86-generic-64 
#@DESCRIPTION: Machine configuration for running a x86-generic-64 machine

DEFAULTTUNE ?= "corei7-64"
require conf/machine/include/tune-corei7.inc
require conf/machine/include/qemu.inc
require conf/machine/include/qemuboot-x86.inc
QB_OPT_APPEND = "-vga vmware -show-cursor -usb -usbdevice tablet -device virtio-rng-pci -smp 2"
#Kernel requires moveb update cpu
QB_CPU_x86-64 = "-cpu Broadwell"
QB_SYSTEM_NAME = "qemu-system-x86_64"

PREFERRED_PROVIDER_virtual/xserver ?= "xserver-xorg"
PREFERRED_PROVIDER_virtual/libgl ?= "mesa"
PREFERRED_PROVIDER_virtual/libgles1 ?= "mesa"
PREFERRED_PROVIDER_virtual/libgles2 ?= "mesa"

KERNEL_IMAGETYPE = "bzImage"

SERIAL_CONSOLE = "115200 ttyS0"

XSERVER = "xserver-xorg \
           ${@bb.utils.contains('DISTRO_FEATURES', 'opengl', 'mesa-driver-swrast', '', d)} \
           xf86-input-vmmouse \
           xf86-input-keyboard \
           xf86-input-evdev \
           xf86-video-cirrus \
           xf86-video-fbdev \
           xf86-video-vmware"

MACHINE_FEATURES += "x86 dpdk"

MACHINE_ESSENTIAL_EXTRA_RDEPENDS += "v86d"

PREFERRED_PROVIDER_virtual/kernel = "linux-yocto"
```

## project/conf/bblayers.conf
```bitbake
# POKY_BBLAYERS_CONF_VERSION is increased each time build/conf/bblayers.conf
# changes incompatibly
POKY_BBLAYERS_CONF_VERSION = "2"

BBPATH = "${TOPDIR}"
BBFILES ?= ""

BBLAYERS ?= " \
  ${TOPDIR}/../layers/poky/meta \
  ${TOPDIR}/../layers/poky/meta-poky \
  ${TOPDIR}/../layers/poky/meta-yocto-bsp \
  ${TOPDIR}/../layers/meta-openembedded/meta-oe \
  ${TOPDIR}/../layers/meta-openembedded/meta-python \
  ${TOPDIR}/../layers/meta-openembedded/meta-filesystems \
  ${TOPDIR}/../layers/meta-openembedded/meta-networking \
  ${TOPDIR}/../layers/meta-openembedded/meta-webserver \
  ${TOPDIR}/../layers/meta-clang \
  ${TOPDIR}/../layers/meta-selinux \
  ${TOPDIR}/../layers/meta-virtualization \
  ${TOPDIR}/../layers/meta-montavista-cgx \
  ${TOPDIR}/../layers/meta-openembedded/meta-perl \
  ${TOPDIR}/../layers/meta-openembedded/meta-gnome \
  ${TOPDIR}/../layers/meta-openembedded/meta-multimedia \
  ${TOPDIR}/../layers/meta-openembedded/meta-xfce \
  ${TOPDIR}/../layers/meta-security \
  ${TOPDIR}/../layers/meta-cgl/meta-cgl-common \
  ${TOPDIR}/../layers/meta-cloud-services \
  ${TOPDIR}/../layers/meta-cloud-services/meta-openstack \
  ${TOPDIR}/../layers/meta-montavista-cgl \
  ${TOPDIR}/../layers/meta-montavista-x86-generic \
  ${TOPDIR}/../layers/meta-qa/meta-qa-framework \
  ${TOPDIR}/../layers/meta-qa/meta-qa-testsuites \
  "
```
